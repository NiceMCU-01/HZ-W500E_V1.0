## firmware/sdkconfig.defaults
```kconfig
# ---- target ----
CONFIG_IDF_TARGET="esp32c3"

# ---- flash ----
CONFIG_ESPTOOLPY_FLASHSIZE_4MB=y
CONFIG_ESPTOOLPY_FLASHMODE_DIO=y
CONFIG_ESPTOOLPY_FLASHFREQ_40M=y
CONFIG_PARTITION_TABLE_CUSTOM=y
CONFIG_PARTITION_TABLE_CUSTOM_FILENAME="partitions.csv"

# ---- console: UART0 @115200, driven by our own AT task ----
CONFIG_ESP_CONSOLE_UART_DEFAULT=y
CONFIG_ESP_CONSOLE_UART_BAUDRATE=115200
CONFIG_ESP_CONSOLE_UART_NUM=0

# AT 固件不需要日志输出，日志会污染 AT 应答
CONFIG_LOG_DEFAULT_LEVEL_NONE=y
CONFIG_LOG_DEFAULT_LEVEL=0
CONFIG_LOG_MAXIMUM_LEVEL_NONE=y
CONFIG_LOG_MAXIMUM_LEVEL=0

# ---- FreeRTOS ----
CONFIG_FREERTOS_HZ=1000
CONFIG_ESP_MAIN_TASK_STACK_SIZE=4096

# ---- W5500 SPI Ethernet（引脚来自 脚为定义.txt）----
# CS=9  RST=6  SCK=7  MISO=3  MOSI=10  INT=8
CONFIG_ETH_USE_ESP32_EMAC=n
CONFIG_ETH_SPI_ETHERNET_W5500=y
CONFIG_ETH_SPI_ETHERNET_CS_GPIO_NUM=9
CONFIG_ETH_SPI_ETHERNET_RST_GPIO_NUM=6
CONFIG_ETH_SPI_ETHERNET_INT_GPIO_NUM=8
CONFIG_ETH_SPI_ETHERNET_MISO_GPIO_NUM=3
CONFIG_ETH_SPI_ETHERNET_MOSI_GPIO_NUM=10
CONFIG_ETH_SPI_ETHERNET_SCLK_GPIO_NUM=7
CONFIG_ETH_SPI_ETHERNET_SPI_SPEED_MHZ=20
CONFIG_ETH_SPI_ETHERNET_SPI_MODE=0

# ---- WiFi ----
CONFIG_ESP_WIFI_ENABLED=y
CONFIG_ESP_WIFI_STATIC_RX_BUFFER_NUM=16
CONFIG_ESP_WIFI_DYNAMIC_RX_BUFFER_NUM=32
CONFIG_ESP_WIFI_AMPDU_TX_ENABLED=n

# lwIP
CONFIG_LWIP_TCP_MSS=1439
# 原来只有 8 个套接字，而 lwIP 会为 TIME_WAIT 连接保留额度。
# AT 固件要频繁开关 TCP 连接，8 个远远不够，实测会在连续测试中耗尽
# （socket() 返回 -1 / errno=23 ENFILE），表现为「一开始能连上、
# 连测几轮后所有连接全部失败」。16 个留出足够余量。
CONFIG_LWIP_MAX_SOCKETS=16
# 加快 TIME_WAIT 回收，减少额度占用
CONFIG_LWIP_TCP_CLOSE_TIMEOUT_MS=3000

# ---- NVS ----
CONFIG_NVS_ENCRYPTION=n

#注意：不要在此开启 CONFIG_LOG_DEFAULT_LEVEL_INFO / CONFIG_LWIP_LOG_LEVEL_WARN。
# AT 固件的所有应答都走同一个 UART，日志会混进 AT 响应，导致命令解析失败、
# 收到的网络数据（如 UDP 回环的 LOOPB）被当成命令残片。排查问题时应临时打开、
# 测完必须关掉并重新烧录。
```
